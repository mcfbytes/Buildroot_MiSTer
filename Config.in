## package/ltunify/Config.in
```kconfig
config BR2_PACKAGE_LTUNIFY
	bool "ltunify"
	select BR2_PACKAGE_LIBEXECINFO if !BR2_TOOLCHAIN_USES_GLIBC
	help
	  ltunify: pair, unpair and inspect devices on a Logitech
	  Unifying receiver, from the command line. It talks to the
	  receiver directly over /dev/hidraw*, writing HID++ 1.0
	  registers, and links against nothing but libc (+ -lrt).

	    ltunify list            show the six pairing slots
	    ltunify pair [timeout]  open the receiver for pairing
	    ltunify unpair idx      free a slot
	    ltunify info idx        per-device detail
	    ltunify receiver-info   receiver firmware/serial

	  WHY IT IS HERE. Nothing else on this image can re-pair a
	  Logitech device to a receiver. The kernel side is complete --
	  CONFIG_HID_LOGITECH_DJ gives each paired device its own input
	  node, and CONFIG_HID_LOGITECH_HIDPP its battery -- but the
	  pairing handshake itself has no kernel interface and no
	  sysfs knob. A device that arrives pre-paired in the box needs
	  none of this; a replacement receiver, a bare dongle off eBay,
	  or two devices being consolidated onto one dongle do.

	  WHAT IT CANNOT DO. Only UNIFYING and NANO receivers:

	    046d:c52b, c532   Unifying          supported
	    046d:c52f, c534   Nano              supported
	    046d:c548         Bolt              NOT supported
	    046d:c539, c53a,
	         c53f, c543   Lightspeed        NOT supported

	  Lightspeed and 27 MHz receivers bind as "logitech-djreceiver"
	  just like Unifying ones, so ltunify's own auto-detection will
	  select one and then fail against it. Bolt goes wrong the other
	  way: this kernel binds it with hid-multitouch, so ltunify does
	  not see it as a receiver at all and reports "not found".
	  ltunify also assumes the FIRST receiver it finds is the one
	  you meant, which is wrong precisely when two are plugged in --
	  and it sees a single Nano receiver as two, because such a
	  receiver owns two hidraw nodes.

	  Both hazards are why this image does not expect anyone to run
	  ltunify by hand. /usr/sbin/mister-pair-logitech enumerates
	  every receiver, classifies it by USB product ID, refuses the
	  unsupported ones by name, and pins the chosen one with
	  ltunify's -d flag. Scripts/pair_logitech.sh on the data
	  partition launches it from the MiSTer Scripts menu.

	  Nothing invokes ltunify automatically: no init script, no
	  udev rule. Pairing is a deliberate act.

	  Upstream has been frozen since 2020-06-14. Accepted -- see
	  package/ltunify/ltunify.mk and docs/logitech-pairing.md,
	  which also record why Solaar (maintained, covers Bolt) is
	  not the choice here: it would pull GTK3 onto an image with
	  no display server.

	  https://github.com/Lekensteyn/ltunify
```

## package/minijail/Config.in
```kconfig
config BR2_PACKAGE_MINIJAIL
	bool "minijail"
	depends on BR2_USE_MMU # fork()
	depends on !BR2_STATIC_LIBS # libminijailpreload.so
	select BR2_PACKAGE_LIBCAP
	help
	  Google's process sandboxing tool: minijail0 runs a program
	  as another uid inside mount/PID/IPC/UTS namespaces with a
	  bind-mount allow-list, a reduced capability set and
	  no_new_privs. libminijailpreload.so is installed for the
	  default (-T dynamic) mode.

	  The DE10 and DE25 kernels have seccomp (-S) and Landlock
	  (--fs-path-*) but no user namespaces. See docs/minijail.md.

	  https://google.github.io/minijail/

comment "minijail needs a toolchain w/ dynamic library"
	depends on BR2_USE_MMU
	depends on BR2_STATIC_LIBS
```

## package/mister-initramfs/Config.in
```kconfig
config BR2_PACKAGE_MISTER_INITRAMFS
	bool "mister-initramfs (stage-1 initramfs cpio for the kernel)"
	select BR2_PACKAGE_MISTER_INITRAMFS_BUSYBOX
	select BR2_PACKAGE_MISTER_INITRAMFS_EXFATPROGS
	help
	  The MiSTer stage-1 initramfs (ADR 0002): a static BusyBox, a
	  static fsck.exfat and board/mister/common/initramfs-overlay/init,
	  packed into images/mister-initramfs.cpio. It replaces stock's
	  in-kernel do_mounts.c patch: /init mounts the SD data partition,
	  loop-mounts linux/linux.img off it and switch_roots into it.

	  It is a PACKAGE of the main build (built with the main toolchain,
	  statically linked) rather than a second Buildroot configuration,
	  so one 'make' produces it and the kernel that embeds it. Enable
	  the kernel side with BR2_LINUX_KERNEL_EXT_MISTER_INITRAMFS (Kernel
	  -> Linux Kernel Extensions), which selects this package and points
	  CONFIG_INITRAMFS_SOURCE at the cpio.

	  Nothing from this package is installed into the rootfs.

	  https://github.com/mcfbytes/Buildroot_MiSTer/blob/master/docs/decisions/0002-initramfs.md

config BR2_PACKAGE_MISTER_INITRAMFS_ITSALIVE
	bool "HDMI splash during the boot-time exFAT repair"
	depends on BR2_PACKAGE_MISTER_INITRAMFS
	depends on BR2_arm # DE10-Nano register map
	depends on BR2_PACKAGE_HOST_RUSTC_TARGET_ARCH_SUPPORTS
	select BR2_PACKAGE_ITSALIVE
	help
	  Puts a full-screen "do not power off" picture on HDMI while
	  /init runs the repair Scripts/check_storage.sh scheduled (ADR
	  0026). Without it that boot is a black screen for as long as
	  fsck.exfat takes.

	  Copies package/itsalive's static binary and two gzipped raw
	  frames from board/mister/de10nano/fsck-splash into the cpio.
	  itsalive is then NOT installed into the rootfs: it must never
	  run beside Main_MiSTer.

config BR2_PACKAGE_MISTER_INITRAMFS_INSTALLER
	bool "SD-card first-boot installer (sdcard.img)"
	depends on BR2_PACKAGE_MISTER_INITRAMFS
	depends on BR2_arm # writes the DE10-Nano's uboot.img
	help
	  Puts the first-boot installer (ADR 0020, as merged into stage
	  1 by ADR 0033) into this cpio: the installer script, a static
	  mkfs.exfat and, with the HDMI splash above, the installer's
	  frames, under /usr/libexec/mister-installer and
	  /usr/share/mister-installer.

	  /init runs it ONLY when the card carries the installer flag
	  that scripts/mk-sdcard.sh puts on sdcard.img (MBR entry 3 plus
	  a magic block at LBA 1024), and the installer spends that flag
	  (wipes the block) as its commit point. Every other boot never
	  reaches it.

	  DE10-Nano only: it writes the DE10's uboot.img.

	  https://github.com/mcfbytes/Buildroot_MiSTer/blob/master/docs/installer-init.md
```

## package/rcheevos/Config.in
```kconfig
config BR2_PACKAGE_RCHEEVOS
	bool "rcheevos"
	depends on BR2_TOOLCHAIN_HAS_THREADS
	help
	  rcheevos: RetroAchievements' own client library. Four pieces
	  in one .so -- rcheevos (evaluating achievement, leaderboard
	  and rich-presence logic against emulated memory), rapi (the
	  RetroAchievements web API request/response marshalling),
	  rhash (game identification hashing, including disc images),
	  and rc_client, the high-level state machine upstream
	  recommends integrating against.

	  It does NOT perform network I/O: the consumer is handed a URL
	  to fetch and passes the response body back in. Nothing on this
	  image links it yet -- it is shipped so a consumer can.

	  Built as a shared library (librcheevos.so.<full version>)
	  with upstream's own -DRC_SHARED plus -fvisibility=hidden, so
	  ONLY the RC_EXPORT-annotated public API is exported -- 264
	  symbols rather than 477. That matters here: the hidden 213
	  include md5_init/md5_append/md5_finish and six AES_* entry
	  points, which would otherwise interpose against a consumer's
	  own md5 and AES code. Patch 0001 annotates rc_util.h, the one
	  public header upstream left un-annotated.

	  The SONAME is the FULL version, deliberately -- upstream gives
	  no ABI guarantee and its caller-allocated public structs have
	  changed layout in PATCH releases (v10.7.1 grew rc_runtime_t,
	  v10.3.3 grew rc_api_login_response_t mid-struct, v6.0.1
	  changed RC_ALIGNMENT). Since the Main_MiSTer binary lives on
	  /media/fat and survives rootfs reflashes, a bump has to be a
	  loud refuse-to-load rather than silent corruption. See
	  package/rcheevos/rcheevos.mk.

	  https://github.com/RetroAchievements/rcheevos

comment "rcheevos needs a toolchain w/ threads"
	depends on !BR2_TOOLCHAIN_HAS_THREADS
```

## package/rtl8852cu-morrownr/Config.in
```kconfig
config BR2_PACKAGE_RTL8852CU_MORROWNR
	bool "rtl8852cu-morrownr"
	depends on BR2_LINUX_KERNEL
	help
	  Out-of-tree Realtek RTL8852CU / RTL8832CU Wi-Fi 6E (2x2,
	  2.4/5/6 GHz) USB WiFi driver from the morrownr fork
	  (kernel-module package). Covers adapters such as the MSI
	  AXE5400, TP-Link Archer TX50UH / TXE70UH and Mercusys MA86XH.

	  Mainline 6.18 has the RTL8852C chip HAL in rtw89 (RTW89_8852C)
	  but only a PCIe bus file for it -- rtw8852ce.c exists,
	  rtw8852cu.c does not -- so RTW89_8852CE is the only offered
	  symbol and it "depends on PCI", which this board does not have.
	  An RTL8852CU dongle therefore has NO in-kernel driver at all,
	  which is the one condition under which ADR 0016 permits an
	  out-of-tree fork. Same nl80211-only CONFIG_WIRELESS_EXT
	  conclusion as the sibling morrownr packages, but re-derived
	  against this driver's own source -- it is the newer Realtek
	  "phl" code base, not the "rtw" base the others share (see
	  rtl8852cu-morrownr.mk for the per-file evidence, the bind-
	  conflict diff, and the two kbuild options this package must
	  pass).

	  No firmware sub-option is needed: this tree links its firmware
	  in as a C array rather than calling request_firmware(), unlike
	  the mainline rtw89 driver.

	  https://github.com/morrownr/rtl8852cu-20251113

comment "rtl8852cu-morrownr needs a Linux kernel to be built"
	depends on !BR2_LINUX_KERNEL
```

## package/sinden-lightgun/Config.in
```kconfig
config BR2_PACKAGE_SINDEN_LIGHTGUN
	bool "sinden-lightgun"
	depends on BR2_PACKAGE_MONO_ARCH_SUPPORTS
	depends on BR2_INSTALL_LIBSTDCPP # mono
	depends on BR2_TOOLCHAIN_HAS_THREADS_NPTL # mono
	depends on !BR2_STATIC_LIBS # mono, libjpeg62
	depends on BR2_arm # installs the armhf (Raspberry Pi) build
	select BR2_PACKAGE_MONO
	select BR2_PACKAGE_SDL
	select BR2_PACKAGE_SDL_IMAGE
	select BR2_PACKAGE_LIBJPEG62
	help
	  Runtime and glue for Sinden Technology's Linux Lightgun driver
	  (the Raspberry Pi build). Sinden's licence forbids anyone else
	  distributing it, so the image carries none of it:
	  Scripts/sinden_lightgun.sh downloads it from sindenlightgun.com
	  onto the card, and a udev rule runs it, pinned to CPU0, while a
	  gun is plugged in. Main_MiSTer already recognises the guns.

	  Everything the driver links against comes from Buildroot: mono,
	  SDL 1.2, SDL_image 1.2 and libjpeg.so.62. The kernel needs the
	  USB video class driver (uvcvideo). See docs/sinden-lightgun.md.

	  https://www.sindenlightgun.com/

if BR2_PACKAGE_SINDEN_LIGHTGUN

config BR2_PACKAGE_SINDEN_LIGHTGUN_TRIM_MONO
	bool "trim mono to what the Sinden driver needs"
	default y
	help
	  Buildroot's mono installs every profile, reference assembly
	  and tool (~200 MB). This keeps only the runtime and the
	  assemblies LightgunMono.exe references (~20 MB).

	  Say n if anything else on the image runs mono: it would fail
	  at run time with "Could not load file or assembly".

endif

comment "sinden-lightgun needs a 32-bit ARM toolchain w/ C++, NPTL, dynamic library"
	depends on BR2_PACKAGE_MONO_ARCH_SUPPORTS
	depends on !BR2_arm || !BR2_INSTALL_LIBSTDCPP || \
		!BR2_TOOLCHAIN_HAS_THREADS_NPTL || BR2_STATIC_LIBS
```
