## package/rtl8188fu/Config.in
```kconfig
config BR2_PACKAGE_RTL8188FU
	bool "rtl8188fu"
	depends on BR2_LINUX_KERNEL
	help
	  Out-of-tree Realtek RTL8188FU USB WiFi driver (kernel-module
	  package, P3.1). NOT sourced from morrownr — morrownr carries no
	  RTL8188FU repo; sourced instead from kelebek333/rtl8188fu, the
	  most actively maintained fork available (see rtl8188fu.mk for the
	  documented deviation and the CONFIG_WIRELESS_EXT analysis).

	  https://github.com/kelebek333/rtl8188fu

comment "rtl8188fu needs a Linux kernel to be built"
	depends on !BR2_LINUX_KERNEL
```

## package/rtl8812au/Config.in
```kconfig
config BR2_PACKAGE_RTL8812AU
	bool "rtl8812au"
	depends on BR2_LINUX_KERNEL
	help
	  Out-of-tree Realtek RTL8812AU USB WiFi driver, sourced from the
	  morrownr fork (kernel-module package, P3.1). Not required for
	  wpa_supplicant -D nl80211 (see rtl8812au.mk for the
	  CONFIG_WIRELESS_EXT analysis).

	  https://github.com/morrownr/8812au-20210820

comment "rtl8812au needs a Linux kernel to be built"
	depends on !BR2_LINUX_KERNEL
```

## package/rtl8814au-morrownr/Config.in
```kconfig
config BR2_PACKAGE_RTL8814AU_MORROWNR
	bool "rtl8814au-morrownr"
	depends on BR2_LINUX_KERNEL
	help
	  Out-of-tree Realtek RTL8814AU 4x4 802.11ac USB WiFi driver from
	  the morrownr fork (kernel-module package). RTL8814AU powers the
	  high-power 4-antenna adapters (Alfa AWUS1900, Netgear A7000,
	  etc.) and has NO mainline USB driver in 6.18 -- rtl8xxxu is
	  802.11n only, and neither rtw88 nor rtw89 cover it -- so an
	  out-of-tree driver is the only option. Same nl80211-only
	  CONFIG_WIRELESS_EXT analysis as the sibling morrownr packages
	  (see rtl8814au-morrownr.mk).

	  Sibling of package/rtl8812au and package/rtl8821au-morrownr: the
	  three morrownr forks together cover the 802.11ac Realtek USB chips
	  mainline still omits (RTL8812AU, RTL8811AU/RTL8821AU, RTL8814AU).

	  https://github.com/morrownr/8814au

comment "rtl8814au-morrownr needs a Linux kernel to be built"
	depends on !BR2_LINUX_KERNEL
```

## package/rtl8821au-morrownr/Config.in
```kconfig
config BR2_PACKAGE_RTL8821AU_MORROWNR
	bool "rtl8821au-morrownr"
	depends on BR2_LINUX_KERNEL
	help
	  Out-of-tree Realtek RTL8811AU/RTL8821AU USB WiFi driver, sourced
	  from the morrownr fork (kernel-module package, P3.1). Not required
	  for wpa_supplicant -D nl80211 (see rtl8821au-morrownr.mk for the
	  CONFIG_WIRELESS_EXT analysis).

	  Named "-morrownr" rather than plain "rtl8821au" because Buildroot
	  upstream already ships its own package/rtl8821au, sourced from a
	  different fork (benetti-engineering/rtl8821au) — same name would
	  collide on both the Kconfig symbol and the Make namespace.

	  https://github.com/morrownr/8821au-20210708

comment "rtl8821au-morrownr needs a Linux kernel to be built"
	depends on !BR2_LINUX_KERNEL
```

## package/rtl8821cu-morrownr/Config.in
```kconfig
config BR2_PACKAGE_RTL8821CU_MORROWNR
	bool "rtl8821cu-morrownr"
	depends on BR2_LINUX_KERNEL
	help
	  Out-of-tree Realtek RTL8811CU/RTL8821CU USB WiFi driver, sourced
	  from the morrownr fork (kernel-module package, P3.1). Not required
	  for wpa_supplicant -D nl80211 (see rtl8821cu-morrownr.mk for the
	  CONFIG_WIRELESS_EXT analysis).

	  Named "-morrownr" rather than plain "rtl8821cu" because Buildroot
	  upstream already ships its own package/rtl8821cu (also morrownr-
	  sourced, coincidentally the same pinned commit) — same name would
	  collide on both the Kconfig symbol and the Make namespace, and
	  would hand version control to Buildroot's release cadence instead
	  of this project's own pin.

	  https://github.com/morrownr/8821cu-20210916

comment "rtl8821cu-morrownr needs a Linux kernel to be built"
	depends on !BR2_LINUX_KERNEL
```

## package/rtl88x2bu/Config.in
```kconfig
config BR2_PACKAGE_RTL88X2BU
	bool "rtl88x2bu"
	depends on BR2_LINUX_KERNEL
	help
	  Out-of-tree Realtek RTL8812BU/RTL8822BU USB WiFi driver, sourced
	  from the morrownr fork (kernel-module package, P3.1). Not required
	  for wpa_supplicant -D nl80211 (see rtl88x2bu.mk for the
	  CONFIG_WIRELESS_EXT analysis).

	  https://github.com/morrownr/88x2bu-20210702

comment "rtl88x2bu needs a Linux kernel to be built"
	depends on !BR2_LINUX_KERNEL
```

## package/xone/Config.in
```kconfig
config BR2_PACKAGE_XONE
	bool "xone"
	depends on BR2_LINUX_KERNEL
	help
	  Out-of-tree GIP (Game Input Protocol) driver for Xbox One and
	  Xbox Series X|S accessories (kernel-module package, P3.2):
	  wired USB controllers/headsets/chatpad, and the Xbox Wireless
	  Dongle (transport/mt76.c talks the dongle's onboard radio
	  directly; it is NOT a Wi-Fi NIC and registers no wiphy).

	  Sourced from dlundqvist/xone, NOT medusalix/xone (the original
	  project) -- medusalix is explicitly in "maintenance mode" (its own
	  README: "will receive only occasional minor fixes", one commit in
	  the 19 months before this pin) and dlundqvist is the README's own
	  named successor, in continuous active development (see xone.mk for
	  the full comparison this project made before picking a fork).

	  FIRMWARE NOTE: the Xbox Wireless Dongle needs
	  /lib/firmware/xow_dongle.bin (and, for this driver, a same-content
	  xone_dongle_<pid>.bin). This package builds and installs the
	  DRIVER MODULES ONLY (unambiguously GPL-2.0-or-later) -- it does
	  NOT fetch, extract, or bundle that firmware itself; see
	  BR2_PACKAGE_XOW_FIRMWARE (package/xow-firmware/) for that, and
	  docs/decisions/0003-xone-firmware.md (Status: Accepted) for the
	  full redistribution analysis this project's maintainer decided.
	  Wired controllers/headsets/chatpad need no firmware at all.

	  https://github.com/dlundqvist/xone

comment "xone needs a Linux kernel to be built"
	depends on !BR2_LINUX_KERNEL
```

## package/xow-firmware/Config.in
```kconfig
config BR2_PACKAGE_XOW_FIRMWARE
	bool "xow-firmware (Xbox Wireless Dongle)"
	depends on BR2_PACKAGE_XONE
	default y
	help
	  Firmware for the Xbox Wireless Dongle (transport/mt76.c in the
	  xone package), fetched and extracted at BUILD TIME from Microsoft's
	  own, officially published Xbox Wireless Adapter driver package --
	  never committed to git (G6), hash-pinned at every step (the
	  downloaded .cab, and the firmware blob extracted from it).

	  This is a maintainer decision (ACCEPTED, 2026-07-13), not a
	  default this package invented: stock bundles this exact firmware
	  (docs/stock-inventory/firmware.md), so redistributing it is
	  what parity requires. The firmware is covered by Microsoft's
	  Terms of Use (https://www.microsoft.com/en-us/legal/terms-of-use),
	  not GPL -- see docs/decisions/0003-xone-firmware.md for the full
	  analysis, provenance, and the options that were weighed before
	  this was decided.

	  Installs as /lib/firmware/xow_dongle.bin (byte-identical name and
	  content to what stock ships) plus a same-content symlink under the
	  filename xone_dongle_02fe.bin, because this project's chosen xone
	  fork (dlundqvist, see package/xone/xone.mk) requests firmware by
	  that newer per-PID name, not the older shared name stock's fork
	  used -- both names must resolve to the same bytes for the driver
	  to actually find it at runtime.

	  Covers BOTH external USB dongles a MiSTer can use: the common
	  0x02fe (Xbox Wireless Adapter for Windows, "S" revision) and the
	  older 0x02e6 (original "Xbox One Wireless Adapter", model 1713).
	  These use genuinely different firmware, so 0x02e6 is fetched and
	  installed as its own distinct blob (xone_dongle_02e6.bin), not a
	  symlink -- see xow-firmware.mk. (Stock's single-file scheme covered
	  only 0x02fe; this is a deliberate improvement.) The two internal
	  laptop-soldered PIDs the driver also binds are not shipped -- they
	  cannot attach to a DE10-Nano.

comment "xow-firmware needs xone to be enabled"
	depends on !BR2_PACKAGE_XONE
```
