## package/7zip/Config.in
```kconfig
config BR2_PACKAGE_7ZIP
	bool "7zip"
	depends on BR2_TOOLCHAIN_HAS_SYNC_4 # __sync_*_4 intrinsics
	depends on BR2_INSTALL_LIBSTDCPP
	depends on BR2_TOOLCHAIN_HAS_THREADS
	depends on BR2_USE_WCHAR
	help
	  7-Zip, the upstream project by Igor Pavlov, built as the native
	  Linux console application `7zz`, plus `7za` and `7zr` compat
	  symlinks to it (`7zr` is stock MiSTer's only 7-Zip binary name,
	  so scripts written against stock keep working).

	  This REPLACES Buildroot's package/p7zip in this image. p7zip is a
	  third-party Unix port, dead upstream since 16.02 (2016) and
	  continued only by a community fork at 17.06 (2022). 7-Zip has had
	  native Linux support since 21.01, so the port buys nothing.

	  It also builds a STATICALLY linked copy and installs it to
	  $(BINARIES_DIR)/7za, where it is picked up as a payload artifact
	  for the exFAT data partition -- /media/fat/linux/7za, the path the
	  MiSTer Downloader hardcodes and otherwise fetches a 2016 binary
	  from the internet to fill. That is the reason this package exists;
	  see ADR 0023 and docs/downloader-contract.md section 4.

	  Formats: 7z, ZIP, TAR, GZIP, BZIP2, XZ, ZSTD, WIM, ISO, CAB, RPM,
	  DEB, ARJ, CPIO, plus extract-only RAR/RAR5 and a long tail of
	  filesystem/disk images (ext, NTFS, FAT, HFS, APFS, VDI, VHDX,
	  QCOW). Strictly a superset of what p7zip's 7za covered.

	  https://7-zip.org  --  https://github.com/ip7z/7zip

comment "7zip needs a toolchain w/ threads, wchar, C++"
	depends on BR2_TOOLCHAIN_HAS_SYNC_4
	depends on !BR2_TOOLCHAIN_HAS_THREADS || !BR2_USE_WCHAR || \
		!BR2_INSTALL_LIBSTDCPP
```

## package/aic8800/Config.in
```kconfig
config BR2_PACKAGE_AIC8800
	bool "aic8800"
	depends on BR2_LINUX_KERNEL
	help
	  Out-of-tree AICSemi AIC8800-family Wi-Fi 6 (802.11ax) + Bluetooth
	  USB driver, plus the firmware blobs it cannot run without.
	  Two kernel modules (aic_load_fw, aic8800_fdrv) and ~6.6 MiB of
	  firmware under /lib/firmware/aic8800*/.

	  Covers the commodity cheap-AX dongle market that has no driver at
	  all in this image today: Tenda U2 (2604:0014), U11 (2604:001f),
	  U11 Pro (2604:0020), TX1U Nano (3625:0110), the TP-Link/Mercury
	  pair (2357:014b, 2357:014e) and the AICSemi-branded IDs under
	  a69c: and 368b: -- 41 IDs in all.

	  Mainline has NO aic8800 driver over any bus, in any tree checked
	  (6.18, 7.2, 7.3-rc) -- no chip HAL, no staging entry, no
	  MAINTAINERS line -- which is the one condition under which
	  ADR 0016 permits an out-of-tree fork. There are zero USB-ID bind
	  conflicts against the in-kernel drivers this image builds.

	  Sourced from shenmintao/aic8800d80, the tree MiSTer stock
	  vendored into its 6.18 kernel fork and whose firmware stock
	  ships. See docs/wifi-parity.md section 10.2 for the provenance
	  and the licence position.

	  https://github.com/shenmintao/aic8800d80

comment "aic8800 needs a Linux kernel to be built"
	depends on !BR2_LINUX_KERNEL
```

## package/dualsensectl/Config.in
```kconfig
config BR2_PACKAGE_DUALSENSECTL
	bool "dualsensectl"
	depends on BR2_USE_MMU                        # dbus (fork)
	depends on BR2_TOOLCHAIN_HAS_THREADS_NPTL     # hidapi
	depends on BR2_TOOLCHAIN_GCC_AT_LEAST_4_9     # hidapi -> libusb
	depends on BR2_PACKAGE_HAS_UDEV               # hidapi; and libudev directly
	select BR2_PACKAGE_HIDAPI
	select BR2_PACKAGE_DBUS
	help
	  dualsensectl: a command-line tool for the Sony PlayStation 5
	  DualSense controller. It talks to the pad directly over
	  /dev/hidraw* (via hidapi's hidraw backend), sending the same
	  DS_OUTPUT reports hid-playstation does, and reaches the parts of
	  the controller the kernel driver exposes no interface for at all:

	    - adaptive trigger effects (feedback, weapon, bow, galloping,
	      machine, vibration, and the raw per-zone forms)
	    - audio routing between the internal speaker and headphone jack,
	      output volume, and rumble/trigger attenuation
	    - microphone mode ('chat'/'asr'/'both') and microphone volume
	    - player/mic LED dimming ("led-brightness")
	    - controller power-off over Bluetooth
	    - firmware info and battery level

	  IT IS NOT A REPLACEMENT FOR THE DUALSENSE KERNEL PATCHES.
	  0033/0037/0042 in board/mister/de10nano/linux-patches/ exist to
	  satisfy interfaces Main_MiSTer consumes and that no userspace
	  process can provide: sysfs LED class devices at a path *under the
	  HID device* (input.cpp's get_led_path() derives it from
	  /proc/bus/input/devices, so a uleds-created classdev under
	  /sys/devices/virtual/leds cannot stand in), and BTN_Z on the
	  existing gamepad input device (vanilla consumes the mic-mute bit
	  in-kernel and never reports it, and moving the button to a second
	  uinput device would shift the gamecontrollerdb bN indices). This
	  package is strictly ADDITIVE to those. See docs/dualsense-tooling.md.

	  NOTE that dualsensectl and hid-playstation both write output
	  reports to the same pad. The driver only writes when one of its
	  update_* flags is set, so they do not fight continuously, but
	  fields they both own (the lightbar in particular) are last-writer-
	  wins. Nothing runs dualsensectl automatically on this image; it is
	  an operator tool.

	  https://github.com/nowrep/dualsensectl

comment "dualsensectl needs udev /dev management and a toolchain w/ NPTL threads, gcc >= 4.9"
	depends on BR2_USE_MMU
	depends on !BR2_PACKAGE_HAS_UDEV || \
		!BR2_TOOLCHAIN_HAS_THREADS_NPTL || \
		!BR2_TOOLCHAIN_GCC_AT_LEAST_4_9
```

## package/font-noto-sans-jp/Config.in
```kconfig
config BR2_PACKAGE_FONT_NOTO_SANS_JP
	bool "font-noto-sans-jp"
	help
	  Noto Sans JP: the Japanese region subset of Google's Noto
	  Sans CJK (kana, kanji and Latin), installed as OpenType
	  (CFF) files under /usr/share/fonts/noto-sans-jp for
	  fontconfig to find.

	  By default only Regular and Bold (about 9 MB).

	  https://github.com/notofonts/noto-cjk

if BR2_PACKAGE_FONT_NOTO_SANS_JP

config BR2_PACKAGE_FONT_NOTO_SANS_JP_ALL_WEIGHTS
	bool "all weights"
	help
	  Install all 7 weights (Thin to Black), about 32 MB.

endif
```

## package/font-noto-sans/Config.in
```kconfig
config BR2_PACKAGE_FONT_NOTO_SANS
	bool "font-noto-sans"
	help
	  Google's Noto Sans typeface (Latin, Greek and Cyrillic),
	  installed as unhinted TrueType files under
	  /usr/share/fonts/noto-sans for fontconfig to find.

	  By default only Regular, Italic, Bold and Bold Italic
	  (about 1.7 MB).

	  https://notofonts.github.io/

if BR2_PACKAGE_FONT_NOTO_SANS

config BR2_PACKAGE_FONT_NOTO_SANS_ALL_WEIGHTS
	bool "all weights and widths"
	help
	  Install all 72 static styles (Thin to Black, Condensed to
	  normal width, upright and italic), about 31 MB.

endif
```

## package/itsalive/Config.in
```kconfig
config BR2_PACKAGE_ITSALIVE
	bool "itsalive"
	depends on BR2_PACKAGE_HOST_RUSTC_TARGET_ARCH_SUPPORTS
	select BR2_PACKAGE_HOST_RUSTC
	help
	  Brings up HDMI and the Linux framebuffer on a MiSTer without
	  Main_MiSTer running: programs the video PLL, the timings and
	  the ADV7513 over the fabric mailbox and i2c, then points the
	  fabric's frame reader at /dev/fb0 -- the same register
	  sequences Main_MiSTer runs, transcribed from it, needing only
	  the menu.rbf U-Boot has already loaded.

	  Its job in this tree is the SD-card installer's first-boot
	  splash (ADR 0020 section 9, issue #185): for the minute the
	  card is being reformatted the board otherwise shows nothing on
	  HDMI, and a first-time user reaches for the power switch at
	  exactly the moment that bricks the card. `itsalive up` then
	  `itsalive image` put "installing, do not power off" on screen.
	  It is also a rescue tool: a shell on a MiSTer with a core
	  loaded gets a screen back with two commands.

	  About 900 KB static on glibc. It ships in exactly one place,
	  the DE10 stage-1 initramfs (BR2_PACKAGE_MISTER_INITRAMFS_ITSALIVE,
	  which keeps it out of the rootfs), where both the first-boot
	  installer (ADR 0033) and the exFAT repair (ADR 0026) use it.
	  Never run it while Main_MiSTer is up: two writers on the
	  mailbox corrupt each other.

	  https://github.com/mcfbytes/ItsAlive_MiSTer

# On a musl toolchain Rust's arch gate also needs BR2_TOOLCHAIN_BUILDROOT_CXX=y
# (package/rustc/Config.in.host); every configuration in this tree is glibc now.
comment "itsalive needs a Rust-supported toolchain (on musl: BR2_TOOLCHAIN_BUILDROOT_CXX=y)"
	depends on BR2_arm
	depends on !BR2_PACKAGE_HOST_RUSTC_TARGET_ARCH_SUPPORTS
```

## package/libjpeg62/Config.in
```kconfig
config BR2_PACKAGE_LIBJPEG62
	bool "libjpeg62 (libjpeg-turbo, 6.2 ABI)"
	depends on !BR2_STATIC_LIBS
	help
	  libjpeg.so.62 alongside the system libjpeg.so.8. Buildroot's
	  jpeg-turbo is always built with the 8 ABI; prebuilt binaries
	  linked against Debian's libjpeg62-turbo need the 6.2 one.

	  Same jpeg-turbo source and version; only the shared library
	  is installed, never headers, so nothing in the build links it.

	  https://libjpeg-turbo.org/

comment "libjpeg62 needs a toolchain w/ dynamic library"
	depends on BR2_STATIC_LIBS
```

## package/linux-firmware-extra/Config.in
```kconfig
config BR2_PACKAGE_LINUX_FIRMWARE_EXTRA
	bool "linux-firmware-extra (sub-option gap fill)"
	depends on BR2_PACKAGE_LINUX_FIRMWARE
	default y
	help
	  Nine firmware files that a currently in-tree 6.18 kernel driver
	  genuinely still requests, but that Buildroot's own linux-firmware
	  package (BR2_PACKAGE_LINUX_FIRMWARE, see the Config.in one menu up)
	  has NO sub-option for -- upstream linux-firmware ships every one of
	  these nine, Buildroot's curated Config.in list just never grew a
	  toggle for them.

	  Four are stock-parity files (docs/stock-inventory/firmware.md).
	  The other five are NOT -- stock ships none of them. The four
	  mediatek/mt7663* back CONFIG_MT7663U=m and rtlwifi/rtl8192dufw.bin
	  backs CONFIG_RTL8192DU=m, both enabled beyond stock; without them
	  those drivers probe and then fail at request_firmware(). See
	  docs/wifi-parity.md sections 6.2 and 7.

	  This package does NOT fetch a tarball of its own: it installs the
	  files straight out of the linux-firmware package's
	  already-extracted tree (hence the `depends on
	  BR2_PACKAGE_LINUX_FIRMWARE` above). That is the identical upstream
	  snapshot, fetched and hash-verified once by linux-firmware, so these
	  files always match the rest of the firmware on the image and there
	  is no separately pinned version to drift -- it previously did,
	  sitting at 20251011 while linux-firmware moved to 20260410. The
	  nine paths below were confirmed present in that extracted tree.

	  Covers: mediatek/mt7610u.bin (MT7610U -- only the "e" PCIe sibling
	  mt7610e.bin has a toggle), mediatek/mt7622pr2h.bin and
	  mediatek/mt7668pr2h.bin (MediaTek Bluetooth companion firmware,
	  requested by drivers/bluetooth/btmtk.h, no toggle), rtlwifi/
	  rtl8723befw_36.bin (requested by the in-tree rtl8723be sub-driver,
	  not listed under RTL_87XX alongside the un-suffixed
	  rtl8723befw.bin), and the four mediatek/mt7663* files MT7663U
	  loads -- mt7663pr2h.bin + mt7663_n9_v3.bin (the offload/v3 path)
	  and mt7663pr2h_rebb.bin + mt7663_n9_rebb.bin (the fallback the
	  driver switches to if the first ROM patch is absent). Both pairs
	  ship because mt7663_load_rom_patch() picks the N9 blob to match
	  whichever ROM patch bound, so a half-set breaks a live path.

	  Also rtlwifi/rtl8192dufw.bin (RTL8192DU 802.11n USB) -- the same
	  "e has a toggle, u does not" gap as mt7610u above: RTL_81XX
	  installs the PCIe sibling rtl8192defw.bin but not the USB one.

	  THREE further stock files with a plausible in-tree consumer --
	  brcm/BCM20702A1-0b05-17cb.hcd, rtl_bt/rtl8723d_config.bin,
	  rtlwifi/rtl8192eefw.bin -- were tried here and dropped: none of the
	  three exist in the linux-firmware tree at all (confirmed against the
	  extracted tree, most recently 20260410, not assumed from the driver
	  side), so no source is available without stepping outside the
	  pinned, hash-verified upstream. Flagged in docs/firmware-parity.md
	  for review rather than sourced from an unpinned mirror (project
	  rule: do not fabricate a source).

	  See docs/firmware-parity.md for the full inventory-vs-built diff:
	  every file's in-tree consumer was checked against THIS project's
	  pinned kernel source (not assumed; last checked on 6.18.33 --
	  re-grep on a kernel bump rather than trusting this line), and the files
	  deliberately NOT reproduced (obsolete driver, no upstream source,
	  or no in-tree consumer at all -- would need a new out-of-tree
	  driver package, out of P3.3's scope) are documented there, not
	  silently dropped.
```

## package/linux-rt/Config.in
```kconfig
config BR2_PACKAGE_LINUX_RT
	bool "linux-rt (PREEMPT_RT kernel variant -> images/zImage_dtb-rt)"
	depends on BR2_LINUX_KERNEL
	depends on BR2_LINUX_KERNEL_EXT_MISTER_INITRAMFS
	help
	  A SECOND kernel built beside the main one (ADR 0021 as amended by
	  ADR 0030): the 7.2.y line with CONFIG_PREEMPT_RT=y, from the same
	  board/mister/de10nano/linux.config plus linux-rt.fragment, patched
	  with board/mister/de10nano/linux-patches-beta (a `series` dir, via
	  BR2_GLOBAL_PATCH_DIR/linux-rt), embedding the same stage-1 cpio.

	  Products: images/zImage_dtb-rt (zImage + DTB, budget-checked by
	  scripts/check-zimage-dtb.sh), images/linux-rt.config, and its
	  depmod'd module tree in the ONE rootfs next to the main kernel's,
	  so switching kernels on the device is a u-boot.txt line and never a
	  rootfs flash (docs/rt-beta-kernel.md §5).

	  The build hard-asserts CONFIG_PREEMPT_RT=y in the built kernel's
	  .config: merge_config.sh only warns when a fragment symbol is
	  dropped, so without it a plain 7.2 kernel could ship labeled RT.

	  Same shape as Buildroot's own barebox-aux: one source, a second
	  configuration, in one tree. `make linux-rt-menuconfig` edits it.

	  https://github.com/mcfbytes/Buildroot_MiSTer/blob/master/docs/rt-beta-kernel.md

if BR2_PACKAGE_LINUX_RT

config BR2_PACKAGE_LINUX_RT_VERSION
	string "kernel version"
	default ""
	help
	  A kernel.org release on the 7.2.y line (PREEMPT_RT for 32-bit ARM
	  landed in 7.1; docs/rt-beta-kernel.md). DELIBERATELY NO DEFAULT:
	  the pin is a line in configs/mister_de10nano_defconfig, next to the
	  6.18 pin, where Renovate bumps it and `savedefconfig` keeps it (a
	  Kconfig default would be dropped from the saved defconfig and the
	  pin would go unmanaged). The tarball's sha256 lives in
	  package/linux-rt/linux-rt.hash, transcribed from kernel.org's
	  PGP-signed sha256sums.asc -- never from a downloaded tarball. A bump
	  must move both, or the download fails closed.

config BR2_PACKAGE_LINUX_RT_CONFIG_FRAGMENT_FILES
	string "kernel config fragment files"
	default "$(BR2_EXTERNAL_MISTER_PATH)/board/mister/de10nano/linux-rt.fragment"
	help
	  Merged onto the main kernel's BR2_LINUX_KERNEL_CUSTOM_CONFIG_FILE.
	  This is the layer that carries CONFIG_PREEMPT_RT=y.

endif
```
