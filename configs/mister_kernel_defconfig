## configs/mister_kernel_defconfig
```kconfig
# mister_kernel_defconfig — the shared KERNEL-ONLY base for kernel variants
# (docs/rt-beta-kernel.md, ADR 0021 as amended 2026-07-18).
#
# This is NOT a second image. It exists so a kernel variant (`make rt`, and any
# future sibling) can build a zImage_dtb + a depmod'd module tree in its own
# O= WITHOUT rebuilding the ~300 MB userland: same toolchain, same kernel
# stanza, no target packages. The per-variant delta lives in
# configs/mister_<variant>.fragment, merged on top by the top-level Makefile
# (same merge_config.sh mechanism the old full-image variant used). With NO
# fragment merged, this file builds the main 6.18 kernel — which is exactly
# what makes the lockstep below testable.
#
# LOCKSTEP: every BR2_ symbol this file shares with mister_de10nano_defconfig
# MUST carry the identical value, or the variant kernel is built by a different
# toolchain / from different sources than the image it plugs into.
# scripts/check-kernel-defconfig-sync.sh asserts exactly that (CI runs it for
# every kernel variant before any cache is restored, and build.yml runs it as
# a lint next to the patch-header lint). Edit the main defconfig's toolchain
# or kernel stanza -> mirror it here in the same commit, or CI fails in
# seconds.

# --- Toolchain & arch/ABI — copied from mister_de10nano_defconfig ------------
# (see that file's header for the full derivation; abi-contract.md §1). The
# kernel itself does not need C++ (BR2_TOOLCHAIN_BUILDROOT_CXX), but the stanza
# is mirrored WHOLE on purpose: partial mirroring is how the two toolchains
# drift. The sync script compares values where a symbol exists in both files
# AND asserts the toolchain-family name sets (BR2_arm*/BR2_ARM_*/BR2_cortex*/
# BR2_KERNEL_HEADERS*/BR2_TOOLCHAIN_BUILDROOT_*) match — choice symbols carry
# their value in the NAME, so dropping or one-sidedly bumping one of these
# lines fails CI rather than silently narrowing the lockstep.
BR2_arm=y
BR2_cortex_a9=y
BR2_ARM_ENABLE_NEON=y
BR2_ARM_ENABLE_VFP=y
BR2_ARM_FPU_NEON=y
BR2_KERNEL_HEADERS_6_18=y
BR2_TOOLCHAIN_BUILDROOT_CXX=y

# --- System shape ------------------------------------------------------------
# Merged /usr, same as the main image: kernel modules physically install under
# usr/lib/modules/<kver>/ (lib -> usr/lib), which is the exact path the main
# rootfs uses — the module tree copied out of this build's target/ must line up
# byte-for-path with where work/extra-modules-overlay/ drops it into the main
# image, or depmod's indexes point nowhere.
BR2_ROOTFS_MERGED_USR=y

# No init system, no shell, no BusyBox: this target rootfs is never booted (it
# exists only to receive the module install + depmod). All THREE lines are
# needed: init/sh choices default to BusyBox, and BR2_PACKAGE_BUSYBOX is
# `default y` in its own right (package/busybox/Config.in), so without the
# explicit not-set it quietly builds anyway — verified by loading this
# defconfig through kconfig with and without the line.
BR2_INIT_NONE=y
BR2_SYSTEM_BIN_SH_NONE=y
# BR2_PACKAGE_BUSYBOX is not set

# --- Download integrity — same posture as the main defconfig -----------------
# BR2_GLOBAL_PATCH_DIR is load-bearing even with no packages: it is where
# Buildroot finds board/mister/de10nano/patches/linux/linux.hash, the ONLY
# thing that hash-verifies a pinned custom kernel download (see that file's
# header for why Buildroot's own lookup misses its shipped hashes).
BR2_GLOBAL_PATCH_DIR="$(BR2_EXTERNAL_MISTER_PATH)/board/mister/de10nano/patches"
BR2_DOWNLOAD_FORCE_CHECK_HASHES=y

# --- Reproducibility — same posture as the main defconfig --------------------
# Not cosmetic even though this rootfs never ships: linux.mk gates
# KBUILD_BUILD_VERSION/USER/HOST/TIMESTAMP on BR2_REPRODUCIBLE
# (work/buildroot/linux/linux.mk:169-175), so without it the variant kernel
# bakes the build machine's real hostname/user/wallclock into its UTS banner —
# and a release.yml re-run on the same tag (a flow that workflow explicitly
# supports) would mint a byte-different zImage_dtb-<variant> and SHA256SUMS
# line, unlike every other shipped binary. As a symbol defined in both files it
# also falls under check-kernel-defconfig-sync.sh's value comparison for free.
BR2_REPRODUCIBLE=y

# --- Kernel stanza — mirrored from mister_de10nano_defconfig -----------------
# Base-without-fragment = the main 6.18 kernel (version, patches, config,
# compression, DTS — all identical). A variant fragment overrides only what it
# must (e.g. mister_rt.fragment: version -> the 7.2 line, patch dir -> the beta
# subset, one kernel-config fragment). The stage-1 initramfs cpio is embedded
# by external.mk's LINUX_KCONFIG_FIXUP_CMDS hook exactly as in the main build
# (it keys on BR2_LINUX_KERNEL=y, not on which defconfig) — which is why the
# Makefile's kernel-variant targets depend on `initramfs`: without the cpio the
# kernel kconfig-fixup fails hard, and a variant zImage without it would panic
# on the FAT root at boot (docs/boot-chain.md I1/I2).
BR2_LINUX_KERNEL=y
BR2_LINUX_KERNEL_CUSTOM_VERSION=y
BR2_LINUX_KERNEL_CUSTOM_VERSION_VALUE="6.18.39"
BR2_LINUX_KERNEL_PATCH="$(BR2_EXTERNAL_MISTER_PATH)/board/mister/de10nano/linux-patches"
BR2_LINUX_KERNEL_USE_CUSTOM_CONFIG=y
BR2_LINUX_KERNEL_CUSTOM_CONFIG_FILE="$(BR2_EXTERNAL_MISTER_PATH)/board/mister/de10nano/linux.config"
BR2_LINUX_KERNEL_LZ4=y
BR2_LINUX_KERNEL_ZIMAGE=y
BR2_LINUX_KERNEL_DTS_SUPPORT=y
BR2_LINUX_KERNEL_INTREE_DTS_NAME="intel/socfpga/socfpga_cyclone5_de10nano"

# --- Host kmod with xz -------------------------------------------------------
# linux.config sets CONFIG_MODULE_COMPRESS_XZ=y, so the .ko land as .ko.xz and
# the build-time depmod (LINUX_RUN_DEPMOD, a target-finalize hook) must be able
# to read them — same line, same reason, as the main defconfig.
BR2_PACKAGE_HOST_KMOD_XZ=y

# --- Rootfs: tar, and ONLY tar -----------------------------------------------
# Deliberate, and load-bearing twice over:
#   1. depmod runs from LINUX_TARGET_FINALIZE_HOOKS (linux.mk), and
#      target-finalize only runs when at least one rootfs image is built —
#      tar is the cheapest one there is. Drop this and the module tree ships
#      WITHOUT modules.dep/modules.alias, i.e. no autoload on device.
#   2. the tar doubles as the module-transport artifact: CI's build-kernel legs
#      tar target/usr/lib/modules into the kernel artifact that the main build
#      job unpacks into work/extra-modules-overlay/.
# No ext2/no linux.img here — this rootfs is never flashed or shipped, which is
# also why there is NO BR2_ROOTFS_POST_BUILD_SCRIPT (post-build.sh only bakes
# /MiSTer.version into a rootfs that ships; this one doesn't).
BR2_TARGET_ROOTFS_TAR=y

# --- Post-image: zImage_dtb assembly -----------------------------------------
# Same script, same BR_DIR-relative path idiom as the main defconfig (post-
# image scripts run with work/buildroot/ as CWD). It cats zImage+DTB into
# images/zImage_dtb and runs scripts/check-zimage-dtb.sh; its linux.img half
# self-gates on BR2_TARGET_ROOTFS_EXT2 (absent here), so a kernel-only build
# gets the kernel artifact and its contract check with nothing else.
BR2_ROOTFS_POST_IMAGE_SCRIPT="../../board/mister/de10nano/post-image.sh"
```

## package/bcm20702-firmware/Config.in
```kconfig
config BR2_PACKAGE_BCM20702_FIRMWARE
	bool "bcm20702-firmware (Broadcom BT dongle firmware)"
	help
	  Broadcom BCM20702 Bluetooth adapter patch-RAM firmware
	  (brcm/BCM20702A1-0b05-17cb.hcd), which btbcm uploads to
	  BCM20702-based USB Bluetooth dongles at power-up -- the common
	  ASUS USB-BT400 (0b05:17cb) and compatible generics. Without it
	  those dongles enumerate but never initialise.

	  Stock-parity firmware (35000 bytes, matching stock exactly),
	  fetched hash-pinned at BUILD TIME from
	  winterheart/broadcom-bt-firmware and NEVER committed to git.
	  This is Broadcom's proprietary firmware, redistributed the same
	  way as xow_dongle.bin -- see docs/decisions/0003-xone-firmware.md
	  and docs/firmware-parity.md.
```

## package/libchdr/Config.in
```kconfig
config BR2_PACKAGE_LIBCHDR
	bool "libchdr"
	select BR2_PACKAGE_ZLIB
	select BR2_PACKAGE_ZSTD
	# BR2_PACKAGE_LZMA_SDK is not an upstream Buildroot symbol -- it is
	# this tree's own BR2_EXTERNAL sibling (package/lzma-sdk), sourced
	# into the same Kconfig tree, so the select is legal.
	select BR2_PACKAGE_LZMA_SDK
	help
	  libchdr: MAME's CHD (Compressed Hunks of Data) read library,
	  maintained standalone by rtissera. Used by Main_MiSTer's cores
	  support for CD-image formats -- PSX/MegaCD/Saturn/etc. cores
	  mount .chd disc images through the chd_* API.

	  Built as a shared library (libchdr.so.0.3) against the SYSTEM
	  zlib, libzstd and liblzma-sdk instead of upstream's vendored
	  deps/ copies -- zlib/zstd via upstream's own WITH_SYSTEM_*
	  options, the LZMA SDK via this package's patches (0001-0003),
	  which add the missing WITH_SYSTEM_LZMA leg in upstream's own
	  pattern. Only the header-only dr_flac decoder stays bundled
	  (public domain / MIT-0; no shared-lib alternative exists, see
	  libchdr.mk).

	  The library exports ONLY chd_* symbols (upstream links with a
	  version script, src/link.T), so it cannot collide with
	  minizip-ng's mz_* namespace or anything else in Main's link.

	  https://github.com/rtissera/libchdr
```

## package/lzma-sdk/Config.in
```kconfig
config BR2_PACKAGE_LZMA_SDK
	bool "lzma-sdk"
	help
	  7-Zip's LZMA SDK (Igor Pavlov's reference LZMA
	  implementation), compiled as a shared library (liblzma-sdk)
	  for Main_MiSTer -- which vendors this exact C code as
	  lib/lzma/ -- and for libchdr, whose CHD v5 LZMA codec is
	  written against this SDK's API. Pure single-threaded C
	  (built under Z7_ST), so it needs no toolchain thread or C++
	  dependencies.

	  This is NOT xz-utils' liblzma.so.5: entirely different API
	  (LzmaDec_*/LzmaEnc_*/LzmaCompress vs lzma_stream_*), and xz
	  is packaged separately by upstream Buildroot as 'xz'.

	  Named "lzma-sdk" rather than plain "lzma" because upstream
	  Buildroot already ships a host-only package/lzma (lzma-utils
	  4.32.7) squatting the unprefixed LZMA_ Make namespace; a
	  same-named package here would silently corrupt host-lzma's
	  download variables rather than error out (the full mechanism
	  is documented in lzma-sdk.mk's header comment).

	  https://www.7-zip.org/sdk.html
```

## package/midilink/Config.in
```kconfig
config BR2_PACKAGE_MIDILINK
	bool "midilink"
	depends on BR2_TOOLCHAIN_HAS_THREADS
	select BR2_PACKAGE_ALSA_LIB
	select BR2_PACKAGE_ALSA_LIB_SEQ
	help
	  MidiLink: the MiSTer-devel daemon that bridges ALSA-sequencer USB
	  MIDI adapters (Minimig, ao486, and other cores) to a real MIDI
	  port, a software synth (MUNT/mt32d -- package/munt -- or
	  FluidSynth), or a network peer (UDP/TCP, incl. a small Hayes "AT"
	  command subset). Stock ships it as /usr/sbin/midilink plus a
	  small companion tool /usr/sbin/mlinkutil (P0.3 inventory:
	  docs/stock-inventory/binaries-needed-full.txt lines 470/480).
	  This is the actual ALSA-sequencer client that makes cores' MIDI
	  ports appear at all -- see docs/midi-mt32-parity.md for why
	  package-manifest.md's "driven directly by the MiSTer binary, not
	  a daemon" note (written before this P0.3 binary was traced to its
	  upstream source) undersold this.

	  Sourced from MiSTer-devel/MidiLink_MiSTer (GPL-3.0+), the
	  project's own official repo (an actively-mirrored community fork,
	  bbond007/MiSTer_MidiLink, exists but was not used -- no evidence
	  it diverges in ways relevant here, and the official repo is
	  simpler to justify as the pin). No release tags exist upstream,
	  so this pins an exact commit (see midilink.mk).

	  Rebuilt against THIS system's alsa-lib (BR2_PACKAGE_ALSA_LIB_SEQ)
	  rather than the arm-linux-gnueabihf-prebuilt alsa headers/libs
	  upstream's own Makefile vendors under alsa/ (G4: do not vendor).

	  Runtime companions, both optional and independently toggled:
	    - BR2_PACKAGE_MUNT (mt32d) for the "MUNT" uartmode.
	    - BR2_PACKAGE_FLUIDSYNTH (+_ALSA_LIB, already enabled) for the
	      "FSYNTH" uartmode -- MidiLink shells out to a bare
	      "fluidsynth" and relies on $PATH, so it does not matter that
	      Buildroot's fluidsynth.mk installs to usr/bin while stock's
	      shipped usr/sbin; both are on this image's PATH.
	  Neither is a hard dependency: MidiLink's default uartmode
	  (USBMIDI, a real USB MIDI adapter) needs neither.

	  https://github.com/MiSTer-devel/MidiLink_MiSTer

comment "midilink needs a toolchain w/ threads"
	depends on !BR2_TOOLCHAIN_HAS_THREADS
```

## package/munt/Config.in
```kconfig
config BR2_PACKAGE_MUNT
	bool "munt"
	depends on BR2_INSTALL_LIBSTDCPP
	depends on BR2_TOOLCHAIN_HAS_THREADS
	select BR2_PACKAGE_ALSA_LIB
	help
	  Munt: a multi-platform software synthesiser emulating Roland's
	  pre-GM MIDI devices (MT-32, CM-32L, CM-64, LAPC-I). Stock ships
	  its console ALSA-sequencer daemon as /usr/sbin/mt32d (P0.3
	  inventory: docs/stock-inventory/binaries-needed-full.txt) --
	  spawned on demand by MidiLink (package/midilink) whenever a core
	  requests MT-32/CM-32 emulation instead of a real MT-32 or a
	  FluidSynth soundfont. Buildroot has no upstream "munt" package,
	  so this builds it from the project's own source (P3.8).

	  This package builds:
	    - libmt32emu (the emulation library, LGPL-2.1+) via munt's own
	      CMake project, restricted to the mt32emu/ subdirectory so
	      the Qt-based mt32emu_qt GUI and the win32 driver are never
	      even configured.
	    - mt32d (the headless console ALSA daemon, also LGPL-2.1+ per
	      its own file header) from mt32emu_alsadrv/src/{console,
	      alsadrv,wav}.cpp, linked against the freshly staged
	      libmt32emu + this system's alsa-lib -- NOT against any
	      vendored ALSA bits (there are none here to vendor; unlike
	      MidiLink upstream, mt32emu_alsadrv already expects a system
	      alsa-lib). xmt32 (the X11 GUI counterpart in the same source
	      directory) is deliberately never built: it needs
	      libX11/libXt/libXpm, none of which this headless image
	      ships, and mt32d alone is everything MidiLink's "MUNT"
	      uartmode shells out to.

	  ROM NOTE: the actual Roland MT32_CONTROL.ROM / MT32_PCM.ROM (and
	  CM-32L equivalents) are Roland's copyrighted firmware. Stock does
	  NOT bundle them -- this package does not fetch, extract, or embed
	  them either (G6). mt32d takes the ROM directory as a `-f <path>`
	  command-line argument at runtime (MidiLink passes stock's default
	  of /media/fat/linux/mt32-rom-data via MidiLink.INI's
	  MUNT_ROM_PATH); users who own real MT-32/CM-32 hardware supply
	  their own dumped ROM files at that path, exactly as in stock. See
	  docs/midi-mt32-parity.md.

	  https://github.com/munt/munt

comment "munt needs a toolchain w/ C++ and threads"
	depends on !BR2_INSTALL_LIBSTDCPP || !BR2_TOOLCHAIN_HAS_THREADS
```

## package/rtl8188eu-aircrack-ng/Config.in
```kconfig
config BR2_PACKAGE_RTL8188EU_AIRCRACK_NG
	bool "rtl8188eu-aircrack-ng"
	depends on BR2_LINUX_KERNEL
	help
	  Out-of-tree Realtek RTL8188EU USB WiFi driver (kernel-module
	  package, P3.1), sourced from aircrack-ng/rtl8188eus. NOT sourced
	  from morrownr — morrownr carries no RTL8188EU repo (see
	  rtl8188eu-aircrack-ng.mk for the documented deviation and the
	  CONFIG_WIRELESS_EXT analysis).

	  Named "-aircrack-ng" rather than plain "rtl8188eu" because
	  Buildroot upstream already ships its own package/rtl8188eu, sourced
	  from a different fork (benetti-engineering/rtl8188eu) — same name
	  would collide on both the Kconfig symbol and the Make namespace.

	  https://github.com/aircrack-ng/rtl8188eus

comment "rtl8188eu-aircrack-ng needs a Linux kernel to be built"
	depends on !BR2_LINUX_KERNEL
```
